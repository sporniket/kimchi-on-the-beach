## src/Kconfig.projbuild
```kconfig
# Copyright 2021,2022 David SPORN
# ---
# This file is part of 'Kimchi on the beach'.
# ---
# 'Kimchi on the beach' is free software: you can redistribute it and/or 
# modify it under the terms of the GNU General Public License as published 
# by the Free Software Foundation, either version 3 of the License, or 
# (at your option) any later version.

# 'Kimchi on the beach' is distributed in the hope that it will be useful, 
# but WITHOUT ANY WARRANTY; without even the implied warranty of 
# MERCHANTABILITY or FITNESS FOR A PARTICULAR PURPOSE. See the GNU General 
# Public License for more details.

# You should have received a copy of the GNU General Public License along 
# with 'Kimchi on the beach'. If not, see <https://www.gnu.org/licenses/>. 

menu "BLE HID COMBO Configuration"

    config LABEL_DEVICE_NAME
        string "Device Name"
        default "The mighty device"
        help
            This label will be displayed in the OS bluetooth configuration panel to designate the device.

    config LABEL_MANUFACTURER_NAME
        string "Manufacturer Name"
        default "A. Nonymous"
        help
            This label will be displayed about the device manufacturer.

    config PIN_STATUS_MAIN
        int "Main LED GPIO number"
        range 0 34
        default 15
        help
            GPIO number (IOxx) for the 'Main status' LED.

    config PIN_STATUS_ALT
        int "Alternate LED GPIO number"
        range 0 34
        default 2
        help
            GPIO number (IOxx) for the 'Alternate status' LED.

    config PIN_STATUS_RGB_RED
        int "RGB LED [RED] GPIO number"
        range 0 34
        default 0
        help
            GPIO number (IOxx) for the 'Alternate status' LED.

    config PIN_STATUS_RGB_GREEN
        int "RGB LED [GREEN] GPIO number"
        range 0 34
        default 4
        help
            GPIO number (IOxx) for the 'Alternate status' LED.

    config PIN_STATUS_RGB_BLUE
        int "RGB LED [BLUE] GPIO number"
        range 0 34
        default 5
        help
            GPIO number (IOxx) for the 'Alternate status' LED.

    config PIN_BUTTON_ACTION_WHITE
        int "BUTTON 'ACTION' [WHITE] GPIO number"
        range 0 34
        default 18
        help
            GPIO number (IOxx) for the button panel : 'action'/'fire'/'ok', white button.

    config PIN_BUTTON_LEFT_YELLOW
        int "BUTTON 'LEFT' [YELLOW] GPIO number"
        range 0 34
        default 19
        help
            GPIO number (IOxx) for the button panel : 'left', yellow button.

    config PIN_BUTTON_DOWN_GREEN
        int "BUTTON 'DOWN' [GREEN] GPIO number"
        range 0 34
        default 21
        help
            GPIO number (IOxx) for the button panel : 'down', green button.

    config PIN_BUTTON_UP_BLUE
        int "BUTTON 'UP' [BLUE] GPIO number"
        range 0 34
        default 22
        help
            GPIO number (IOxx) for the button panel : 'up', blue button.

    config PIN_BUTTON_RIGHT_RED
        int "BUTTON 'RIGHT' [RED] GPIO number"
        range 0 34
        default 23
        help
            GPIO number (IOxx) for the button panel : 'right', red button.

endmenu
```
